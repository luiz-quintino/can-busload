VERSION ""

NS_ :

BS_:

BU_: DIAG ECU

BO_ 2564475124 STATUS: 8 DIAG
 SG_ N_PDU : 7|64@0+ (1,0) [0|0] "-"  ECU

BO_ 2564554484 STATUS_3: 8 DIAG
 SG_ N_PDU : 7|64@0+ (1,0) [0|0] ""  ECU

BO_ 2564458484 DIAGNOSTIC_RT: 8 DIAG
 SG_ N_PDU : 7|64@0+ (1,0) [0|0] ""  ECU

BO_ 2564486344 DIAGNOSTIC_RD: 8 ECU
 SG_ N_PDU : 7|64@0+ (1,0) [0|0] "-"  DIAG

BO_ 2564486279 STATUS_2: 8 ECU
 SG_ N_PDU : 7|64@0+ (1,0) [0|0] ""  DIAG

CM_ "Project_281_ProjectStandard_B-CAN1 [07338]";
CM_ SG_ 2564475124 N_PDU "-";
CM_ SG_ 2564554484 N_PDU "This signal is used for diagnostic purposes";
CM_ SG_ 2564458484 N_PDU "This signal is used for diagnostic purposes";
CM_ SG_ 2564486344 N_PDU "-";
CM_ SG_ 2564486279 N_PDU "This signal is used for diagnostic purposes";
BA_DEF_ SG_  "GenSigStartValue" INT 0 2147483647;
BA_DEF_ SG_  "GenSigInactiveValue" INT 0 2147483647;
BA_DEF_ SG_  "GenSigSendType" ENUM  "NotUsed","OnWrite","OnWriteWithRepetition","OnChange","OnChangeWithRepetition","IfActive","IfActiveWithRepetition","NoSigSendType";
BA_DEF_ SG_  "GenSigTimeoutTime_DIAG_TEST" INT 0 65535;
BA_DEF_ SG_  "GenSigTimeoutTime_SGW" INT 0 65535;
BA_DEF_ BO_  "DiagRequest" ENUM  "No","Yes";
BA_DEF_ BO_  "Type" ENUM  "P","C","PE","COC","PE_Cntrl","E","E_Cntrl","OC","S","BAF","DC","EM","MM","-";
BA_DEF_ BO_  "DiagResponse" ENUM  "No","Yes";
BA_DEF_ BO_  "NmMessage" ENUM  "No","Yes";
BA_DEF_ BO_  "GenMsgSendType" ENUM  "Cyclic","NotUsed","NotUsed","NotUsed","NotUsed","NotUsed","NotUsed","NotUsed","NoMsgSendType";
BA_DEF_ BO_  "GenMsgILSupport" ENUM  "No","Yes";
BA_DEF_ BO_  "GenMsgCycleTime" INT 0 65535;
BA_DEF_ BO_  "NmAsrMessage" ENUM  "No","Yes";
BA_DEF_ BO_  "DiagState" ENUM  "No","Yes";
BA_DEF_ BO_  "DiagConnection" HEX 0 65535;
BA_DEF_ BU_  "Description" STRING ;
BA_DEF_ BU_  "NmStationAddress" HEX 0 255;
BA_DEF_ BU_  "NmNode" ENUM  "No","Yes";
BA_DEF_ BU_  "NmAsrNode" ENUM  "No","Yes";
BA_DEF_ BU_  "NmAsrNodeIdentifier" HEX 0 255;
BA_DEF_ BU_  "NmAsrCanMsgReducedTime" INT 1 65535;
BA_DEF_  "Manufacturer" STRING ;
BA_DEF_  "NmType" STRING ;
BA_DEF_  "Baudrate" INT 0 1000000;
BA_DEF_  "DBName" STRING ;
BA_DEF_  "NmAsrTimeoutTime" INT 1 65535;
BA_DEF_  "NmAsrWaitBusSleepTime" INT 1 65535;
BA_DEF_  "NmAsrRepeatMessageTime" INT 1 65535;
BA_DEF_  "NmAsrMessageCount" INT 1 256;
BA_DEF_  "NmAsrBaseAddress" HEX 235487232 2147483647;
BA_DEF_  "NmAsrCanMsgCycleTime" INT 1 65535;
BA_DEF_  "Version" HEX 0 255;
BA_DEF_  "VersionWeek" INT 0 53;
BA_DEF_  "VersionYear" INT 0 99;
BA_DEF_DEF_  "GenSigStartValue" 0;
BA_DEF_DEF_  "GenSigInactiveValue" 0;
BA_DEF_DEF_  "GenSigSendType" "NoSigSendType";
BA_DEF_DEF_  "GenSigTimeoutTime_DIAG_TEST" 2500;
BA_DEF_DEF_  "GenSigTimeoutTime_SGW" 2500;
BA_DEF_DEF_  "DiagRequest" "No";
BA_DEF_DEF_  "Type" "-";
BA_DEF_DEF_  "DiagResponse" "No";
BA_DEF_DEF_  "NmMessage" "No";
BA_DEF_DEF_  "GenMsgSendType" "NoMsgSendType";
BA_DEF_DEF_  "GenMsgILSupport" "No";
BA_DEF_DEF_  "GenMsgCycleTime" 0;
BA_DEF_DEF_  "NmAsrMessage" "No";
BA_DEF_DEF_  "DiagState" "No";
BA_DEF_DEF_  "DiagConnection" 0;
BA_DEF_DEF_  "Description" "";
BA_DEF_DEF_  "NmStationAddress" 0;
BA_DEF_DEF_  "NmNode" "Yes";
BA_DEF_DEF_  "NmAsrNode" "Yes";
BA_DEF_DEF_  "NmAsrNodeIdentifier" 0;
BA_DEF_DEF_  "NmAsrCanMsgReducedTime" 100;
BA_DEF_DEF_  "Manufacturer" "Fiat";
BA_DEF_DEF_  "NmType" "";
BA_DEF_DEF_  "Baudrate" 500000;
BA_DEF_DEF_  "DBName" "CAN";
BA_DEF_DEF_  "NmAsrTimeoutTime" 1000;
BA_DEF_DEF_  "NmAsrWaitBusSleepTime" 750;
BA_DEF_DEF_  "NmAsrRepeatMessageTime" 800;
BA_DEF_DEF_  "NmAsrMessageCount" 256;
BA_DEF_DEF_  "NmAsrBaseAddress" 506724352;
BA_DEF_DEF_  "NmAsrCanMsgCycleTime" 200;
BA_DEF_DEF_  "Version" 160;
BA_DEF_DEF_  "VersionWeek" 50;
BA_DEF_DEF_  "VersionYear" 18;
BA_ "Manufacturer" "F";
BA_ "NmAsrCanMsgCycleTime" 1000;
BA_ "NmAsrRepeatMessageTime" 4500;
BA_ "NmAsrWaitBusSleepTime" 1000;
BA_ "NmAsrTimeoutTime" 8000;
BA_ "Baudrate" 125000;
BA_ "NmType" "NmAsr";
BA_ "DBName" "BCAN";
BA_ "Description" BU_ DIAG "Diagnostic Tester";
BA_ "NmAsrNodeIdentifier" BU_ ECU 112;
BA_ "NmStationAddress" BU_ ECU 112;
BA_ "Description" BU_ ECU "Security Gateway Module";
BA_ "GenMsgCycleTime" BO_ 2564475124 100;
BA_ "DiagConnection" BO_ 2564475124 62664;
BA_ "Type" BO_ 2564475124 8;
BA_ "DiagRequest" BO_ 2564475124 1;
BA_ "DiagConnection" BO_ 2564554484 62718;
BA_ "DiagState" BO_ 2564554484 1;
BA_ "Type" BO_ 2564554484 8;
BA_ "GenMsgCycleTime" BO_ 2564554484 10;
BA_ "DiagConnection" BO_ 2564458484 62599;
BA_ "Type" BO_ 2564458484 8;
BA_ "DiagRequest" BO_ 2564458484 1;
BA_ "GenMsgCycleTime" BO_ 2564458484 1000;
BA_ "DiagConnection" BO_ 2564486344 62664;
BA_ "DiagResponse" BO_ 2564486344 1;
BA_ "Type" BO_ 2564486344 8;
BA_ "DiagConnection" BO_ 2564486279 62599;
BA_ "DiagResponse" BO_ 2564486279 1;
BA_ "Type" BO_ 2564486279 8;
BA_ "GenSigTimeoutTime_SGW" SG_ 2564475124 N_PDU 0;
BA_ "GenSigTimeoutTime_DIAG_TEST" SG_ 2564475124 N_PDU 0;
BA_ "GenSigTimeoutTime_SGW" SG_ 2564554484 N_PDU 0;
BA_ "GenSigTimeoutTime_DIAG_TEST" SG_ 2564554484 N_PDU 0;
BA_ "GenSigTimeoutTime_SGW" SG_ 2564458484 N_PDU 0;
BA_ "GenSigTimeoutTime_DIAG_TEST" SG_ 2564458484 N_PDU 0;
BA_ "GenSigTimeoutTime_SGW" SG_ 2564486344 N_PDU 0;
BA_ "GenSigTimeoutTime_DIAG_TEST" SG_ 2564486344 N_PDU 0;
BA_ "GenSigTimeoutTime_SGW" SG_ 2564486279 N_PDU 0;
BA_ "GenSigTimeoutTime_DIAG_TEST" SG_ 2564486279 N_PDU 0;
